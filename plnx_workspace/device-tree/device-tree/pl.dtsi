/*
 * CAUTION: This file is automatically generated by Xilinx.
 * Version:  
 * Today is: Wed May 31 05:02:55 2023
 */


/dts-v1/;
/plugin/;
/ {
	fragment@0 {
		target = <&fpga_full>;
		overlay0: __overlay__ {
			#address-cells = <2>;
			#size-cells = <2>;
			firmware-name = "project_1.bit.bin";
		};
	};
};
